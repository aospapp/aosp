## device/ti/beagle_x15/beagle_x15.its
```
/dts-v1/;

/ {
	description = "beagle-x15";
	#address-cells = <1>;

	images {
		kernel@1 {
			description = "TI kernel";
			data = /incbin/("zImage");
			type = "kernel";
			arch = "arm";
			os = "linux";
			compression = "none";
			load = <0x82000000>;
			entry = <0x82000000>;
		};
		ramdisk@1 {
			description = "Android Ramdisk Image";
			data = /incbin/("ramdisk.img");
			type = "ramdisk";
			arch = "arm";
			os = "linux";
			compression = "none";
			load = <0x88080000>;
			entry = <0x88080000>;
		};
		fdt@1 {
			description = "AM57xx-beagle-x15-revc";
			data = /incbin/("am57xx-beagle-x15-revc.dtb");
			type = "flat_dt";
			arch = "arm";
			compression = "none";
			load = <0x83000000>;
		};
		fdt@2 {
			description = "AM57xx-evm-common overlay";
			data = /incbin/("am57xx-evm-common.dtbo");
			type = "flat_dt";
			arch = "arm";
			compression = "none";
			load = <0x83080000>;
		};
		fdt@3 {
			description = "AM57xx-evm-reva3 overlay";
			data = /incbin/("am57xx-evm-reva3.dtbo");
			type = "flat_dt";
			arch = "arm";
			compression = "none";
			load = <0x83090000>;
		};

	};

	configurations {
		default = "am57xx-beagle-x15-revc.dtb";
		am57xx-beagle-x15-revc.dtb {
			description = "AM57xx beagle-x15 C";
			kernel = "kernel@1";
			ramdisk = "ramdisk@1";
			fdt = "fdt@1";
		};
		am57xx-evm-reva3.dtb {
			description = "AM57xx EVM rev A3";
			kernel = "kernel@1";
			ramdisk = "ramdisk@1";
			fdt = "fdt@1", "fdt@2", "fdt@3";
		};
	};
};
```
